## meta-isengard/conf/layer.conf
```bitbake
BBPATH .= ":${LAYERDIR}"

BBFILES += "${LAYERDIR}/recipes*/*/*.bb ${LAYERDIR}/recipes*/*/*.bbappend ${LAYERDIR}/images/*.bb"

BBFILE_COLLECTIONS += "meta-isengard"
BBFILE_PATTERN_meta-isengard := "^${LAYERDIR}/"
BBFILE_PRIORITY_meta-isengard = "32"

LAYERSERIES_COMPAT_meta-isengard = "walnascar"
LAYERDEPENDS_meta-isengard = "meta-virtioso tegra"
```
